## Esp32_project/sensor/Kconfig
```kconfig
menu "Sensor Configuration"
    config SENSOR_ENABLE
        bool "Enable Sensor"
        default y
        help
            Виберіть це, щоб активувати роботу датчика.
endmenu
```
